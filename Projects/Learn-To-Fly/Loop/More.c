//**********************************************************************************************
//								BASIC INFORMATION ABOUT THIS PROGRAM
//***********************************************************************************************
//File name:	main.c
//Data:			04/02/2010
//Version:		01.00
//Company:		
//Details: 		Blink LED on Explorer 18 Development Board 
//				Language C: MCC18 compiler
//				Fosc=11.0592MHz, Tcy=362ns
//Author:		Joe Eastman	
//*****************************************************************************************************************
//										HEADER FILES
//*****************************************************************************************************************
#include "p24Fxxxx.h"	//Include to allow selection of device

//*****************************************************************************************************************
//									CONFIGURATION BITS
//*****************************************************************************************************************
//#if defined (__PIC24FJ128GA010)
	_CONFIG1(JTAGEN_OFF & FWDTEN_OFF);
	//_CONFIG2();
//#endif

//*****************************************************************************************************************
//									DEFINES
//*****************************************************************************************************************
#define SHORT_DELAY 100
#define LONG_DELAY 800

//*****************************************************************************************************************
//									VARIABLES
//*****************************************************************************************************************
//Array to spell out "HELLO"
char bitmap[30] = {
	0b11111111,		//H
	0b00001000,
	0b00001000,
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	0b00000000,
};

main()
{
	int index = 0;
	
	TRISA = 0xFF00;		//Set PORTA as outputs
	
	//Init Timer 1
	T1CONbits.TON = 1;
	T1CONbits.TCS = 0;
	T1CONbits.TCKPS0 = 1;
	T1CONbits.TCKPS1 = 1;
	T1CONbits.TGATE = 0;
	T1CONbits.TSYNC = 0;
	T1CONbits.TSIDL = 0;
	
	while(1)
	{
		PORTA = 0xFF;
		for(index = 0; index < 30; index++)
		{
			PORTA = bitmap[index];
			
			//Short Pause
			TMR1 = 0;
			while(TMR1 < LONG_DELAY) //SHORT_DELAY)
			{
			}
		}
		
		PORTA = 0;
		
		TMR1 = 0;
		while(TMR1 < LONG_DELAY)
		{
		}
		
//		PORTA = 0x00;		
	}//End of Main Loop	
}//End of Main
